## components/lcd_3.97_nt35510_xpt2046/Kconfig
```kconfig
menu "nt35510 configuration"
    choice NT35510_CHOICE
        prompt "Select 8 or 16 bit"
        default BIT_MODE_8BIT
        config BIT_MODE_8BIT
            bool "Use 8bits."

        config BIT_MODE_16BIT
            bool "Use 16bits."

    endchoice
    
    config I2S_PORT_NUM
        int "I2S port"
        range 0 1
        default 0

    menu "0-7pins"
        config LCD_D0_PIN
            int "GPIO for LCD D0"
            range 0 39
            default 23
    
        config LCD_D1_PIN
            int "GPIO for LCD D1"
            range 0 39
            default 22
    
        config LCD_D2_PIN
            int "GPIO for LCD D2"
            range 0 39
            default 21
    
        config LCD_D3_PIN
            int "GPIO for LCD D3"
        range 0 39
            default 19
    
        config LCD_D4_PIN
            int "GPIO for LCD D4"
            range 0 39
            default 18
    
        config LCD_D5_PIN
            int "GPIO for LCD D5"
            range 0 39
            default 5
    
        config LCD_D6_PIN
            int "GPIO for LCD D6"
            range 0 39
            default 17
    
        config LCD_D7_PIN
            int "GPIO for LCD D7"
            range 0 39
            default 16
    endmenu
    
    menu "8-15pins"
        depends on BIT_MODE_16BIT

        config LCD_D8_PIN
            int "GPIO for LCD D8"
            range 0 39
            default 0

        config LCD_D9_PIN
            int "GPIO for LCD D9"
            range 0 39
            default 0

        config LCD_D10_PIN
            int "GPIO for LCD D10"
            range 0 39
            default 0

        config LCD_D11_PIN
            int "GPIO for LCD D11"
            range 0 39
            default 0

        config LCD_D12_PIN
            int "GPIO for LCD D12"
            range 0 39
            default 0

        config LCD_D13_PIN
            int "GPIO for LCD D13"
            range 0 39
            default 0

        config LCD_D14_PIN
            int "GPIO for LCD D14"
            range 0 39
            default 0
            
        config LCD_D15_PIN
            int "GPIO for LCD D15"
            range 0 39
            default 0
    endmenu
        
    config LCD_WR_PIN
        int "GPIO for LCD WR"
        range 0 39
        default 2

    config LCD_RS_PIN
        int "GPIO for LCD RS"
        range 0 39
        default 4

    config LCD_RST_PIN
        int "GPIO for LCD RST"
        range 0 39
        default 15

endmenu

menu "Touchpanel Configuration (XPT2046)"

    choice
        prompt "Touch Controller SPI Bus."
        
        default LV_TOUCH_CONTROLLER_SPI_VSPI if !IDF_TARGET_ESP32S2
        default LV_TOUCH_CONTROLLER_SPI_FSPI if IDF_TARGET_ESP32S2
        help
            Select the SPI Bus the TFT Display is attached to.
    
        config LV_TOUCH_CONTROLLER_SPI_HSPI
            bool "HSPI"
        config LV_TOUCH_CONTROLLER_SPI_VSPI
            bool "VSPI" if !IDF_TARGET_ESP32S2
        config LV_TOUCH_CONTROLLER_SPI_FSPI
            bool "FSPI" if IDF_TARGET_ESP32S2
    endchoice
    
    config LV_TOUCH_X_MIN
        int
        prompt "Minimum X coordinate value."
        default 0 if LV_PREDEFINED_PINS_38V4
        default 200

    config LV_TOUCH_Y_MIN
        int
        prompt "Minimum Y coordinate value."
        default 0 if LV_PREDEFINED_PINS_38V4
        default 120

    config LV_TOUCH_X_MAX
        int
        prompt "Maximum X coordinate value."
        default 4095 if LV_PREDEFINED_PINS_38V4
        default 1900

    config LV_TOUCH_Y_MAX
        int
        prompt "Maximum Y coordinate value."
        default 4095 if LV_PREDEFINED_PINS_38V4
        default 1900
    
    config LV_TOUCH_XY_SWAP
        bool
        prompt "Swap XY."
        default y

    config LV_TOUCH_INVERT_X
        bool
        prompt "Invert X coordinate value."
        default y

    config LV_TOUCH_INVERT_Y
        bool
        prompt "Invert Y coordinate value."
        default y

    choice
        prompt "Select touch detection method."
        default LV_TOUCH_DETECT_IRQ
        help
            Select the controller for your touch panel.

        config LV_TOUCH_DETECT_IRQ
            bool "IRQ pin only"
        config LV_TOUCH_DETECT_IRQ_PRESSURE
            bool "IRQ pin and pressure"
        config LV_TOUCH_DETECT_PRESSURE
            bool "Pressure only"
    endchoice

    menu "Pin Assignments"
        config LV_TOUCH_SPI_MISO
            int
            prompt "GPIO for MISO (Master In Slave Out)"
	    range 0 39	
            default 35 if LV_PREDEFINED_PINS_38V1
            default 12
            help
            Configure the touchpanel MISO pin here.

        config LV_TOUCH_SPI_MOSI
            int
            prompt "GPIO for MOSI (Master Out Slave In)"
	    range 0 39	
            default 32 if LV_PREDEFINED_PINS_38V1
            default 13
            help
            Configure the touchpanel MOSI pin here.

        config LV_TOUCH_SPI_CLK
            int "GPIO for CLK (SCK / Serial Clock)"
	    range 0 39	
            default 26 if LV_PREDEFINED_PINS_38V1
            default 14
            help
            Configure the touchpanel CLK pin here.

        config LV_TOUCH_SPI_CS
            int "GPIO for CS (Slave Select)"
	    range 0 39	
            default 33 if LV_PREDEFINED_PINS_38V1
            default 27
            help
            Configure the touchpanel CS pin here.

        config LV_TOUCH_PIN_IRQ
            int "GPIO for IRQ (Interrupt Request)"
	    range 0 39	
            default 27 if LV_PREDEFINED_PINS_38V4
            default 26
            help
            Configure the touchpanel IRQ pin here.
    endmenu
endmenu
```
